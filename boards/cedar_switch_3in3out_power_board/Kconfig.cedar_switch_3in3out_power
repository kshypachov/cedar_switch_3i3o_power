## boards/cedar_switch_3in3out_power_board/Kconfig.cedar_switch_3in3out_power
```kconfig
# Copyright (c) 2017 Florian Vaussard, HEIG-VD
# SPDX-License-Identifier: Apache-2.0

config BOARD_CEDAR_SWITCH_3IN3OUT_POWER
	select SOC_STM32F411XE
```

## boards/cedar_switch_3in3out_power_board/board.yml
```yaml
board:
  name: cedar_switch_3in3out_power
  full_name: Cedar Switch 3in3out Power
  vendor: st
  socs:
    - name: stm32f411xe
```

## boards/cedar_switch_3in3out_power_board/cedar_switch_3in3out_power_defconfig
```kconfig
# SPDX-License-Identifier: Apache-2.0

# Enable MPU
#CONFIG_ARM_MPU=y

# Enable HW stack protection
#CONFIG_HW_STACK_PROTECTION=y

#CONFIG_SERIAL=n

# console
#CONFIG_CONSOLE=n
#CONFIG_UART_CONSOLE=n

# enable GPIO
#CONFIG_GPIO=y

#CONFIG_ARM=y

#CONFIG_SOC_SERIES_STM32F4X=y
#CONFIG_SOC_STM32F412CX=y
#CONFIG_CLOCK_CONTROL=y

#CONFIG_SOC_SERIES_STM32F4X=y
#CONFIG_SOC_STM32F412CX=y  # вместо STM32F412XE
CONFIG_SERIAL=y
CONFIG_CONSOLE=y
CONFIG_UART_CONSOLE=y
# Добавьте эти строки для исправления архитектуры
#CONFIG_ARM=y
#CONFIG_CPU_CORTEX_M4=y
```

## boards/cedar_switch_3in3out_power_rev2/Kconfig.cedar_switch_3in3out_power_rev2
```kconfig
# Copyright (c) 2017 Powersoft
# SPDX-License-Identifier: Apache-2.0

config BOARD_CEDAR_SWITCH_3IN3OUT_POWER_REV2
	select SOC_STM32F412CX
```

## boards/cedar_switch_3in3out_power_rev2/board.yml
```yaml
board:
  name: cedar_switch_3in3out_power_rev2
  full_name: STM32F412G cedar_switch_3in3out_power_rev2
  vendor: st
  socs:
    - name: stm32f412cx
```

## boards/cedar_switch_3in3out_power_rev2/cedar_switch_3in3out_power_rev2_defconfig
```kconfig
# SPDX-License-Identifier: Apache-2.0

# Enable MPU
CONFIG_ARM_MPU=y

# Enable HW stack protection
CONFIG_HW_STACK_PROTECTION=y

##CONFIG_SERIAL=y

# console
##CONFIG_CONSOLE=y
##CONFIG_UART_CONSOLE=y

# enable GPIO ports A, B, C, D, E
CONFIG_GPIO=y

##CONFIG_MBEDTLS=y
##CONFIG_MBEDTLS_BUILTIN=y           # использовать встроенный mbedTLS из Zephyr
##CONFIG_MBEDTLS_TLS_VERSION_1_2=y   # TLS 1.2 (на Cortex-M4 это реалистично)

# Базовые крипто-алгоритмы (минимум для ECDHE/ECDSA и/или PSK)
##CONFIG_MBEDTLS_ECP_C=y
##CONFIG_MBEDTLS_ECDH_C=y
##CONFIG_MBEDTLS_ECDSA_C=y
##CONFIG_MBEDTLS_ENTROPY_C=y

# Управление кучей mbedTLS (вариант через Zephyr heap)
##CONFIG_MBEDTLS_ENABLE_HEAP=y
 # подбери под себя, см. раздел "Память"
##CONFIG_MBEDTLS_HEAP_SIZE=32768
# Уменьшение рекорд-баффера TLS (экономит RAM, но ограничивает размер фрейма)
##CONFIG_MBEDTLS_SSL_MAX_CONTENT_LEN=4096

##CONFIG_TEST_RANDOM_GENERATOR=y

##CONFIG_MBEDTLS_KEY_EXCHANGE_PSK_ENABLED=y

# KEX: только PSK (никакого ECC)
##CONFIG_MBEDTLS_KEY_EXCHANGE_PSK_ENABLED=y
##CONFIG_MBEDTLS_ECDSA_C=n
##CONFIG_MBEDTLS_ECDH_C=n
##CONFIG_MBEDTLS_ECP_C=n

# Криптопримитивы (минимум)
##CONFIG_MBEDTLS_ENTROPY_C=y
```

## build/Kconfig/arch/Kconfig
```kconfig
# Load Zephyr Arch Kconfig descriptions.
osource "/Users/kiro/zephyrproject/zephyr/arch/rx/Kconfig"
osource "/Users/kiro/zephyrproject/zephyr/arch/x86/Kconfig"
osource "/Users/kiro/zephyrproject/zephyr/arch/xtensa/Kconfig"
osource "/Users/kiro/zephyrproject/zephyr/arch/sparc/Kconfig"
osource "/Users/kiro/zephyrproject/zephyr/arch/riscv/Kconfig"
osource "/Users/kiro/zephyrproject/zephyr/arch/posix/Kconfig"
osource "/Users/kiro/zephyrproject/zephyr/arch/mips/Kconfig"
osource "/Users/kiro/zephyrproject/zephyr/arch/arm64/Kconfig"
osource "/Users/kiro/zephyrproject/zephyr/arch/arm/Kconfig"
osource "/Users/kiro/zephyrproject/zephyr/arch/arc/Kconfig"
```

## build/Kconfig/boards/Kconfig.cedar_switch_3in3out_power
```kconfig
# Load board Kconfig descriptions.
osource "/Users/kiro/zephyrproject/zephyr/boards/arm/cedar_switch_3in3out_power_board/Kconfig.cedar_switch_3in3out_power"
```

## build/Kconfig/boards/Kconfig.defconfig
```kconfig
# Load Zephyr board defconfig descriptions.
osource "/Users/kiro/zephyrproject/zephyr/boards/arm/cedar_switch_3in3out_power_board/Kconfig.defconfig"
```

## build/Kconfig/boards/Kconfig.sysbuild
```kconfig
# Load Sysbuild board Kconfig descriptions.
osource "/Users/kiro/zephyrproject/zephyr/boards/arm/cedar_switch_3in3out_power_board/Kconfig.sysbuild"
```

## build/Kconfig/soc/Kconfig
```kconfig
# Load Zephyr SoC Kconfig descriptions.
osource "/Users/kiro/zephyrproject/zephyr/soc/xlnx/zynqmp/Kconfig"
osource "/Users/kiro/zephyrproject/zephyr/soc/xlnx/zynq7000/Kconfig"
osource "/Users/kiro/zephyrproject/zephyr/soc/xlnx/versalnet/Kconfig"
osource "/Users/kiro/zephyrproject/zephyr/soc/xlnx/versal2/Kconfig"
osource "/Users/kiro/zephyrproject/zephyr/soc/xen/Kconfig"
osource "/Users/kiro/zephyrproject/zephyr/soc/wch/ch32v/Kconfig"
osource "/Users/kiro/zephyrproject/zephyr/soc/ti/simplelink/Kconfig"
osource "/Users/kiro/zephyrproject/zephyr/soc/ti/mspm0/Kconfig"
osource "/Users/kiro/zephyrproject/zephyr/soc/ti/lm3s6965/Kconfig"
osource "/Users/kiro/zephyrproject/zephyr/soc/ti/k3/Kconfig"
osource "/Users/kiro/zephyrproject/zephyr/soc/telink/tlsr/Kconfig"
osource "/Users/kiro/zephyrproject/zephyr/soc/starfive/jh71xx/Kconfig"
osource "/Users/kiro/zephyrproject/zephyr/soc/st/stm32/Kconfig"
osource "/Users/kiro/zephyrproject/zephyr/soc/snps/qemu_arc/Kconfig"
osource "/Users/kiro/zephyrproject/zephyr/soc/snps/nsim/arc_v/Kconfig"
osource "/Users/kiro/zephyrproject/zephyr/soc/snps/nsim/arc_classic/Kconfig"
osource "/Users/kiro/zephyrproject/zephyr/soc/snps/hsdk4xd/Kconfig"
osource "/Users/kiro/zephyrproject/zephyr/soc/snps/hsdk/Kconfig"
osource "/Users/kiro/zephyrproject/zephyr/soc/snps/emsk/Kconfig"
osource "/Users/kiro/zephyrproject/zephyr/soc/snps/emsdp/Kconfig"
osource "/Users/kiro/zephyrproject/zephyr/soc/snps/arc_iot/Kconfig"
osource "/Users/kiro/zephyrproject/zephyr/soc/silabs/Kconfig"
osource "/Users/kiro/zephyrproject/zephyr/soc/sifive/sifive_freedom/Kconfig"
osource "/Users/kiro/zephyrproject/zephyr/soc/sensry/Kconfig"
osource "/Users/kiro/zephyrproject/zephyr/soc/rockchip/Kconfig"
osource "/Users/kiro/zephyrproject/zephyr/soc/renode/riscv_virtual/Kconfig"
osource "/Users/kiro/zephyrproject/zephyr/soc/renode/cortex_r8_virtual/Kconfig"
osource "/Users/kiro/zephyrproject/zephyr/soc/renesas/smartbond/Kconfig"
osource "/Users/kiro/zephyrproject/zephyr/soc/renesas/rz/Kconfig"
osource "/Users/kiro/zephyrproject/zephyr/soc/renesas/rx/Kconfig"
osource "/Users/kiro/zephyrproject/zephyr/soc/renesas/rcar/Kconfig"
osource "/Users/kiro/zephyrproject/zephyr/soc/renesas/ra/Kconfig"
osource "/Users/kiro/zephyrproject/zephyr/soc/realtek/ec/Kconfig"
osource "/Users/kiro/zephyrproject/zephyr/soc/raspberrypi/rpi_pico/Kconfig"
osource "/Users/kiro/zephyrproject/zephyr/soc/quicklogic/eos_s3/Kconfig"
osource "/Users/kiro/zephyrproject/zephyr/soc/qemu/virt_riscv/Kconfig"
osource "/Users/kiro/zephyrproject/zephyr/soc/qemu/malta/Kconfig"
osource "/Users/kiro/zephyrproject/zephyr/soc/openisa/rv32m1/Kconfig"
osource "/Users/kiro/zephyrproject/zephyr/soc/openhwgroup/cva6/Kconfig"
osource "/Users/kiro/zephyrproject/zephyr/soc/oct/osd32mp15x/Kconfig"
osource "/Users/kiro/zephyrproject/zephyr/soc/nxp/s32/Kconfig"
osource "/Users/kiro/zephyrproject/zephyr/soc/nxp/rw/Kconfig"
osource "/Users/kiro/zephyrproject/zephyr/soc/nxp/mcx/Kconfig"
osource "/Users/kiro/zephyrproject/zephyr/soc/nxp/lpc/Kconfig"
osource "/Users/kiro/zephyrproject/zephyr/soc/nxp/layerscape/Kconfig"
osource "/Users/kiro/zephyrproject/zephyr/soc/nxp/kinetis/Kconfig"
osource "/Users/kiro/zephyrproject/zephyr/soc/nxp/imxrt/Kconfig"
osource "/Users/kiro/zephyrproject/zephyr/soc/nxp/imx/Kconfig"
osource "/Users/kiro/zephyrproject/zephyr/soc/nuvoton/numicro/Kconfig"
osource "/Users/kiro/zephyrproject/zephyr/soc/nuvoton/numaker/Kconfig"
osource "/Users/kiro/zephyrproject/zephyr/soc/nuvoton/npcx/Kconfig"
osource "/Users/kiro/zephyrproject/zephyr/soc/nuvoton/npcm/Kconfig"
osource "/Users/kiro/zephyrproject/zephyr/soc/nordic/Kconfig"
osource "/Users/kiro/zephyrproject/zephyr/soc/neorv32/Kconfig"
osource "/Users/kiro/zephyrproject/zephyr/soc/native/inf_clock/Kconfig"
osource "/Users/kiro/zephyrproject/zephyr/soc/microchip/sam/Kconfig"
osource "/Users/kiro/zephyrproject/zephyr/soc/microchip/miv/Kconfig"
osource "/Users/kiro/zephyrproject/zephyr/soc/microchip/mec/Kconfig"
osource "/Users/kiro/zephyrproject/zephyr/soc/mediatek/mt8xxx/Kconfig"
osource "/Users/kiro/zephyrproject/zephyr/soc/lowrisc/opentitan/Kconfig"
osource "/Users/kiro/zephyrproject/zephyr/soc/litex/litex_vexriscv/Kconfig"
osource "/Users/kiro/zephyrproject/zephyr/soc/ite/ec/Kconfig"
osource "/Users/kiro/zephyrproject/zephyr/soc/intel/raptor_lake/Kconfig"
osource "/Users/kiro/zephyrproject/zephyr/soc/intel/lakemont/Kconfig"
osource "/Users/kiro/zephyrproject/zephyr/soc/intel/intel_socfpga_std/Kconfig"
osource "/Users/kiro/zephyrproject/zephyr/soc/intel/intel_socfpga/Kconfig"
osource "/Users/kiro/zephyrproject/zephyr/soc/intel/intel_niosv/Kconfig"
osource "/Users/kiro/zephyrproject/zephyr/soc/intel/intel_ish/Kconfig"
osource "/Users/kiro/zephyrproject/zephyr/soc/intel/intel_adsp/Kconfig"
osource "/Users/kiro/zephyrproject/zephyr/soc/intel/elkhart_lake/Kconfig"
osource "/Users/kiro/zephyrproject/zephyr/soc/intel/atom/Kconfig"
osource "/Users/kiro/zephyrproject/zephyr/soc/intel/apollo_lake/Kconfig"
osource "/Users/kiro/zephyrproject/zephyr/soc/intel/alder_lake/Kconfig"
osource "/Users/kiro/zephyrproject/zephyr/soc/infineon/cat3/Kconfig"
osource "/Users/kiro/zephyrproject/zephyr/soc/infineon/cat1c/Kconfig"
osource "/Users/kiro/zephyrproject/zephyr/soc/infineon/cat1b/Kconfig"
osource "/Users/kiro/zephyrproject/zephyr/soc/infineon/cat1a/Kconfig"
osource "/Users/kiro/zephyrproject/zephyr/soc/gd/gd32/Kconfig"
osource "/Users/kiro/zephyrproject/zephyr/soc/gaisler/leon3/Kconfig"
osource "/Users/kiro/zephyrproject/zephyr/soc/gaisler/gr716a/Kconfig"
osource "/Users/kiro/zephyrproject/zephyr/soc/espressif/Kconfig"
osource "/Users/kiro/zephyrproject/zephyr/soc/ene/kb1200/Kconfig"
osource "/Users/kiro/zephyrproject/zephyr/soc/ene/kb106x/Kconfig"
osource "/Users/kiro/zephyrproject/zephyr/soc/efinix/sapphire/Kconfig"
osource "/Users/kiro/zephyrproject/zephyr/soc/cdns/xtensa_sample_controller/Kconfig"
osource "/Users/kiro/zephyrproject/zephyr/soc/cdns/sample_controller32/Kconfig"
osource "/Users/kiro/zephyrproject/zephyr/soc/cdns/dc233c/Kconfig"
osource "/Users/kiro/zephyrproject/zephyr/soc/brcm/bcmvk/Kconfig"
osource "/Users/kiro/zephyrproject/zephyr/soc/brcm/bcm2712/Kconfig"
osource "/Users/kiro/zephyrproject/zephyr/soc/brcm/bcm2711/Kconfig"
osource "/Users/kiro/zephyrproject/zephyr/soc/bflb/Kconfig"
osource "/Users/kiro/zephyrproject/zephyr/soc/atmel/sam0/Kconfig"
osource "/Users/kiro/zephyrproject/zephyr/soc/atmel/sam/Kconfig"
osource "/Users/kiro/zephyrproject/zephyr/soc/aspeed/Kconfig"
osource "/Users/kiro/zephyrproject/zephyr/soc/arm/Kconfig"
osource "/Users/kiro/zephyrproject/zephyr/soc/arm/beetle/Kconfig"
osource "/Users/kiro/zephyrproject/zephyr/soc/antmicro/myra/Kconfig"
osource "/Users/kiro/zephyrproject/zephyr/soc/andestech/Kconfig"
osource "/Users/kiro/zephyrproject/zephyr/soc/amd/acp_6_0/Kconfig"
osource "/Users/kiro/zephyrproject/zephyr/soc/ambiq/Kconfig"
osource "/Users/kiro/zephyrproject/zephyr/soc/aesc/Kconfig"
osource "/Users/kiro/zephyrproject/zephyr/soc/adi/max32/Kconfig"
```
